## CMakeLists.txt
```
cmake_minimum_required(VERSION 3.20.0)
find_package(Zephyr REQUIRED HINTS $ENV{ZEPHYR_BASE})
project(keygen)
target_sources(app PRIVATE src/main.c)
target_sources_ifdef(CONFIG_ENTROPY_OT_CSRNG app PRIVATE src/entropy_ot_csrng.c)
```

## Kconfig
```
# Драйвер энтропии для CSRNG OpenTitan лежит в приложении: в Zephyr 3.7 его нет
config ENTROPY_OT_CSRNG
    bool "OpenTitan CSRNG entropy driver"
    default y
    depends on ENTROPY_GENERATOR
    select ENTROPY_HAS_DRIVER

source "Kconfig.zephyr"
```

## prj.conf
```kconfig
# UART-консоль включена в defconfig платы
CONFIG_PRINTK=y

# PSA Crypto API, реализация из Mbed TLS
CONFIG_MBEDTLS=y
CONFIG_MBEDTLS_PSA_CRYPTO_C=y

# psa_crypto_init() вызываем сами, чтобы увидеть код результата
CONFIG_MBEDTLS_INIT=n

# Источник энтропии - наш драйвер CSRNG (src/entropy_ot_csrng.c)
CONFIG_ENTROPY_GENERATOR=y

# PSA берёт случайные байты у криптостойкого генератора Zephyr,
# а тот - у драйвера энтропии
CONFIG_MBEDTLS_PSA_CRYPTO_EXTERNAL_RNG=y
```

## app.overlay
```dts
/*
 * CSRNG и entropy_src OpenTitan Earl Grey (адреса из top_earlgrey.h).
 * В описании платы Zephyr 3.7 этих блоков нет, добавляем их сами.
 */
/ {
    chosen {
        zephyr,entropy = &csrng;
    };
};

&{/soc} {
    csrng: rng@41150000 {
        compatible = "lowrisc,opentitan-csrng";
        reg = <0x41150000 0x1000>, <0x41160000 0x1000>;
        reg-names = "csrng", "entropy_src";
        status = "okay";
    };
};
```

## dts/bindings/lowrisc,opentitan-csrng.yaml
```yaml
description: OpenTitan CSRNG + entropy_src (драйвер энтропии из этого приложения)

compatible: "lowrisc,opentitan-csrng"

include: base.yaml

properties:
  reg:
    required: true
```

## src/main.c
```c
/*
 * ЛР3. UART-сервис генерации ключевого материала (Zephyr 3.7.0, OpenTitan Earl Grey).
 *
 * Команды (по одной в строке, конец строки - \r или \n):
 *   STATUS - состояние сервиса и результат psa_crypto_init()
 *   GENKEY - 32 случайных байта (256 бит) из psa_generate_random() в HEX
 *   EXIT   - завершение сервиса
 * Без рабочего источника энтропии GENKEY отвечает ошибкой: запасного
 * некриптографического генератора в сервисе нет.
 */
#include <zephyr/kernel.h>
#include <zephyr/device.h>
#include <zephyr/drivers/uart.h>
#include <zephyr/sys/printk.h>
#include <zephyr/sys/util.h>
#include <psa/crypto.h>
#include <mbedtls/platform_util.h>
#include <errno.h>
#include <stdbool.h>
#include <stdio.h>
#include <string.h>

#define LINE_MAX_LEN 32
#define KEY_BYTES 32

static const struct device *const uart = DEVICE_DT_GET(DT_CHOSEN(zephyr_console));
static psa_status_t psa_init_status;

static void reply(const char *s)
{
    while (*s != '\0') {
        uart_poll_out(uart, *s++);
    }
    uart_poll_out(uart, '\r');
    uart_poll_out(uart, '\n');
}

/* Читает строку до \r или \n. Возвращает длину или -1, если строка не влезла */
static int read_line(char *buf, size_t size)
{
    size_t len = 0;
    bool too_long = false;
    unsigned char c;

    while (true) {
        if (uart_poll_in(uart, &c) != 0) {
            continue;
        }
        if (c == '\r' || c == '\n') {
            break;
        }
        if (len < size - 1) {
            buf[len++] = (char)c;
        } else {
            too_long = true;
        }
    }
    buf[len] = '\0';
    return too_long ? -1 : (int)len;
}

static void cmd_genkey(void)
{
    uint8_t key[KEY_BYTES];
    char hex[2 * KEY_BYTES + 1];
    char out[sizeof("KEY:") + sizeof(hex)];
    psa_status_t st;

    if (psa_init_status != PSA_SUCCESS) {
        snprintf(out, sizeof(out), "ERR:NO_ENTROPY psa=%d", (int)psa_init_status);
        reply(out);
        return;
    }

    st = psa_generate_random(key, sizeof(key));
    if (st != PSA_SUCCESS) {
        snprintf(out, sizeof(out), "ERR:KEYGEN psa=%d", (int)st);
        reply(out);
        return;
    }

    bin2hex(key, sizeof(key), hex, sizeof(hex));
    snprintf(out, sizeof(out), "KEY:%s", hex);
    reply(out);

    /* Затираем ключ так, чтобы компилятор не выбросил обнуление */
    mbedtls_platform_zeroize(key, sizeof(key));
    mbedtls_platform_zeroize(hex, sizeof(hex));
    mbedtls_platform_zeroize(out, sizeof(out));
}

int main(void)
{
    char line[LINE_MAX_LEN];
    char out[48];
    int len;

    if (!device_is_ready(uart)) {
        printk("ERROR: UART not ready\n");
        return -ENODEV;
    }

    psa_init_status = psa_crypto_init();

    printk("Key generation service on %s\n", CONFIG_BOARD_TARGET);
    printk("psa_crypto_init: %d\n", (int)psa_init_status);
    printk("READY\n");

    while (true) {
        len = read_line(line, sizeof(line));
        if (len == 0) {
            continue; /* пустая строка, например \n после \r */
        }

        if (len < 0) {
            reply("ERR:TOO_LONG");
        } else if (strcmp(line, "STATUS") == 0) {
            snprintf(out, sizeof(out), "OK:READY psa=%d", (int)psa_init_status);
            reply(out);
        } else if (strcmp(line, "GENKEY") == 0) {
            cmd_genkey();
        } else if (strcmp(line, "EXIT") == 0) {
            reply("OK:BYE");
            break;
        } else {
            reply("ERR:UNKNOWN_CMD");
        }
    }

    printk("Key generation service stopped\n");
    return 0;
}
```

## src/entropy_ot_csrng.c
```c
/*
 * Драйвер энтропии Zephyr для CSRNG OpenTitan Earl Grey.
 *
 * В Zephyr 3.7 такого драйвера нет, поэтому он лежит в приложении.
 * Порядок включения повторяет криптобиблиотеку OpenTitan
 * (sw/device/lib/crypto/drivers/entropy.c): entropy_src в FIPS-режиме
 * с аппаратным кондиционированием, данные идут в CSRNG; затем CSRNG и
 * команда Instantiate с затравкой из entropy_src. get_entropy() выдаёт
 * результат команды Generate блоками по 128 бит.
 * Регистры - csrng.hjson и entropy_src.hjson (OpenTitan earlgrey_1.0.0).
 */
#define DT_DRV_COMPAT lowrisc_opentitan_csrng

#include <zephyr/kernel.h>
#include <zephyr/device.h>
#include <zephyr/drivers/entropy.h>
#include <zephyr/init.h>
#include <zephyr/sys/printk.h>
#include <zephyr/sys/sys_io.h>
#include <zephyr/sys/util.h>
#include <errno.h>
#include <string.h>

/* CSRNG */
#define CSRNG_CTRL            0x14
#define CSRNG_CMD_REQ         0x18
#define CSRNG_SW_CMD_STS      0x2c
#define CSRNG_GENBITS_VLD     0x30
#define CSRNG_GENBITS         0x34
#define CSRNG_RECOV_ALERT_STS 0x50
#define CSRNG_ERR_CODE        0x54
#define CSRNG_MAIN_SM_STATE   0x5c
#define CSRNG_CTRL_RESVAL     0x9999

#define STS_CMD_RDY      BIT(1)
#define STS_CMD_ACK      BIT(2)
#define STS_CMD_STS(reg) (((reg) >> 3) & 0x7)
#define GENBITS_VLD      BIT(0)

/* entropy_src */
#define ES_MODULE_ENABLE   0x20
#define ES_CONF            0x24
#define ES_ENTROPY_CONTROL 0x28
#define ES_DEBUG_STATUS    0xd0
#define ES_RECOV_ALERT_STS 0xd4
#define ES_ERR_CODE        0xd8
#define ES_MAIN_SM_STATE   0xe0

/* Многобитовые булевы значения OpenTitan */
#define MUBI4_TRUE  0x6
#define MUBI4_FALSE 0x9

/* CONF: FIPS_ENABLE[3:0], FIPS_FLAG[7:4], RNG_FIPS[11:8], RNG_BIT_ENABLE[15:12],
 * THRESHOLD_SCOPE[21:18], ENTROPY_DATA_REG_ENABLE[25:22] */
#define ES_CONF_FIPS (MUBI4_TRUE | (MUBI4_TRUE << 4) | (MUBI4_TRUE << 8) | \
                      (MUBI4_FALSE << 12) | (MUBI4_FALSE << 18) | (MUBI4_FALSE << 22))
/* ENTROPY_CONTROL: ES_ROUTE = false (в CSRNG), ES_TYPE = false (с кондиционированием) */
#define ES_CONTROL_HW (MUBI4_FALSE | (MUBI4_FALSE << 4))
/* CSRNG CTRL: ENABLE, SW_APP_ENABLE, READ_INT_STATE = true; FIPS_FORCE_ENABLE = false */
#define CSRNG_CTRL_ON (MUBI4_TRUE | (MUBI4_TRUE << 4) | (MUBI4_TRUE << 8) | (MUBI4_FALSE << 12))

/* Заголовок команды: acmd[3:0], clen[7:4], flag0[11:8], glen[30:12].
 * flag0 = false - затравка берётся из entropy_src */
#define CMD_INSTANTIATE 1
#define CMD_GENERATE    3
#define CMD_HEADER(acmd, glen) ((acmd) | (MUBI4_FALSE << 8) | ((uint32_t)(glen) << 12))

#define MAX_GEN_BLOCKS 0x800  /* предел NIST SP 800-90A на одну команду */
#define POLL_LIMIT     200000

struct ot_csrng_config {
    mm_reg_t csrng;
    mm_reg_t es;
};

/* Состояние регистров после запуска - для журнала */
static struct {
    int init_ret;
    uint32_t es_sm, es_dbg, es_recov, es_err;
    uint32_t cs_sts, cs_sm, cs_recov, cs_err;
} diag;

static int wait_bits(mm_reg_t reg, uint32_t mask)
{
    for (int i = 0; i < POLL_LIMIT; i++) {
        if ((sys_read32(reg) & mask) == mask) {
            return 0;
        }
    }
    return -ETIMEDOUT;
}

static int send_cmd(const struct ot_csrng_config *cfg, uint32_t header)
{
    if (wait_bits(cfg->csrng + CSRNG_SW_CMD_STS, STS_CMD_RDY) != 0) {
        return -ETIMEDOUT;
    }
    sys_write32(header, cfg->csrng + CSRNG_CMD_REQ);
    return 0;
}

static int wait_ack(const struct ot_csrng_config *cfg)
{
    if (wait_bits(cfg->csrng + CSRNG_SW_CMD_STS, STS_CMD_ACK) != 0) {
        return -ETIMEDOUT;
    }
    return STS_CMD_STS(sys_read32(cfg->csrng + CSRNG_SW_CMD_STS)) == 0 ? 0 : -EIO;
}

/* Одна команда Generate на n байт (не больше MAX_GEN_BLOCKS блоков) */
static int generate(const struct ot_csrng_config *cfg, uint8_t *buf, size_t n)
{
    size_t blocks = DIV_ROUND_UP(n, 16);
    uint32_t words[4];
    int ret;

    ret = send_cmd(cfg, CMD_HEADER(CMD_GENERATE, blocks));
    if (ret != 0) {
        return ret;
    }

    for (size_t b = 0; b < blocks; b++) {
        size_t chunk = MIN(n, sizeof(words));

        if (wait_bits(cfg->csrng + CSRNG_GENBITS_VLD, GENBITS_VLD) != 0) {
            return -ETIMEDOUT;
        }
        for (int i = 0; i < 4; i++) {
            words[i] = sys_read32(cfg->csrng + CSRNG_GENBITS);
        }
        memcpy(buf, words, chunk);
        buf += chunk;
        n -= chunk;
    }
    memset(words, 0, sizeof(words));

    return wait_ack(cfg);
}

static int ot_csrng_get_entropy(const struct device *dev, uint8_t *buf, uint16_t len)
{
    const struct ot_csrng_config *cfg = dev->config;

    while (len > 0) {
        size_t n = MIN(len, MAX_GEN_BLOCKS * 16);
        int ret = generate(cfg, buf, n);

        if (ret != 0) {
            return ret;
        }
        buf += n;
        len -= n;
    }
    return 0;
}

static void save_diag(const struct ot_csrng_config *cfg, int ret)
{
    diag.init_ret = ret;
    diag.es_sm = sys_read32(cfg->es + ES_MAIN_SM_STATE);
    diag.es_dbg = sys_read32(cfg->es + ES_DEBUG_STATUS);
    diag.es_recov = sys_read32(cfg->es + ES_RECOV_ALERT_STS);
    diag.es_err = sys_read32(cfg->es + ES_ERR_CODE);
    diag.cs_sts = sys_read32(cfg->csrng + CSRNG_SW_CMD_STS);
    diag.cs_sm = sys_read32(cfg->csrng + CSRNG_MAIN_SM_STATE);
    diag.cs_recov = sys_read32(cfg->csrng + CSRNG_RECOV_ALERT_STS);
    diag.cs_err = sys_read32(cfg->csrng + CSRNG_ERR_CODE);
}

static int ot_csrng_init(const struct device *dev)
{
    const struct ot_csrng_config *cfg = dev->config;
    int ret;

    /* Остановить оба блока: настраивать entropy_src можно только выключенным */
    sys_write32(CSRNG_CTRL_RESVAL, cfg->csrng + CSRNG_CTRL);
    sys_write32(MUBI4_FALSE, cfg->es + ES_MODULE_ENABLE);

    /* entropy_src: FIPS-режим, данные в CSRNG; окна и пороги тестов - по умолчанию */
    sys_write32(ES_CONTROL_HW, cfg->es + ES_ENTROPY_CONTROL);
    sys_write32(ES_CONF_FIPS, cfg->es + ES_CONF);
    sys_write32(0, cfg->es + ES_RECOV_ALERT_STS);
    sys_write32(MUBI4_TRUE, cfg->es + ES_MODULE_ENABLE);

    sys_write32(0, cfg->csrng + CSRNG_RECOV_ALERT_STS);
    sys_write32(CSRNG_CTRL_ON, cfg->csrng + CSRNG_CTRL);

    ret = send_cmd(cfg, CMD_HEADER(CMD_INSTANTIATE, 0));
    if (ret == 0) {
        ret = wait_ack(cfg);
    }
    save_diag(cfg, ret);
    return ret;
}

static const struct entropy_driver_api ot_csrng_api = {
    .get_entropy = ot_csrng_get_entropy,
};

static const struct ot_csrng_config ot_csrng_cfg = {
    .csrng = DT_INST_REG_ADDR_BY_NAME(0, csrng),
    .es = DT_INST_REG_ADDR_BY_NAME(0, entropy_src),
};

DEVICE_DT_INST_DEFINE(0, ot_csrng_init, NULL, NULL, &ot_csrng_cfg,
                      PRE_KERNEL_1, CONFIG_ENTROPY_INIT_PRIORITY, &ot_csrng_api);

/* Перед main() сообщаем в журнал, запустился ли драйвер, и состояние блоков */
static int ot_csrng_report(void)
{
    const struct device *dev = DEVICE_DT_INST_GET(0);

    printk("Entropy: %s %s (init %d)\n", dev->name,
           device_is_ready(dev) ? "ready" : "NOT READY", diag.init_ret);
    printk("  entropy_src: sm=0x%03x dbg=0x%08x recov=0x%x err=0x%x\n",
           diag.es_sm, diag.es_dbg, diag.es_recov, diag.es_err);
    printk("  csrng: sts=0x%x sm=0x%03x recov=0x%x err=0x%x\n",
           diag.cs_sts, diag.cs_sm, diag.cs_recov, diag.cs_err);
    return 0;
}
SYS_INIT(ot_csrng_report, APPLICATION, 0);
```
